## Config.in
```kconfig
source "$BR2_EXTERNAL_COMMS_CHAMP_PATH/package/cc-comms/Config.in"
source "$BR2_EXTERNAL_COMMS_CHAMP_PATH/package/cc-mqtt311/Config.in"
source "$BR2_EXTERNAL_COMMS_CHAMP_PATH/package/cc-mqtt311-libs/Config.in"
source "$BR2_EXTERNAL_COMMS_CHAMP_PATH/package/cc-mqtt5/Config.in"
source "$BR2_EXTERNAL_COMMS_CHAMP_PATH/package/cc-mqtt5-libs/Config.in"
source "$BR2_EXTERNAL_COMMS_CHAMP_PATH/package/cc-mqttsn/Config.in"
source "$BR2_EXTERNAL_COMMS_CHAMP_PATH/package/cc-mqttsn-libs/Config.in"
source "$BR2_EXTERNAL_COMMS_CHAMP_PATH/package/cc-ublox/Config.in"
source "$BR2_EXTERNAL_COMMS_CHAMP_PATH/package/cc-x509/Config.in"

source "$BR2_EXTERNAL_COMMS_CHAMP_PATH/package/cc-commsdsl/Config.in.host"
```

## package/cc-comms/Config.in
```kconfig
config BR2_PACKAGE_CC_COMMS
	bool "cc-comms"
	depends on BR2_INSTALL_LIBSTDCPP
	help
	  Core component of the CommsChampion Ecosystem. C++(11) library to
	  implement binary communication protocols.

comment "cc-comms support needs a toolchain w/ C++"
	depends on !BR2_INSTALL_LIBSTDCPP
```

## package/cc-commsdsl/Config.in.host
```kconfig
comment "host cc-commsdsl needs a toolchain w/ host gcc >= 8.0"
	depends on !BR2_HOST_GCC_AT_LEAST_8

config BR2_PACKAGE_HOST_CC_COMMSDSL
	bool "host cc-commsdsl"
	depends on BR2_HOST_GCC_AT_LEAST_8
	help
	  Code generators of the CommsChampion Ecosystem.
	  Provides main commsdl2comms code generator.

if BR2_PACKAGE_HOST_CC_COMMSDSL

config BR2_PACKAGE_HOST_CC_COMMSDSL2TEST
	bool "host commsdsl2test"
	help
	  Code generator of the CommsChampion Ecosystem.
	  Provides commsdl2test code generator.

config BR2_PACKAGE_HOST_CC_COMMSDSL2TOOLS_QT
	bool "host commsdsl2tools_qt"
	help
	  Code generator of the CommsChampion Ecosystem.
	  Provides commsdl2tools_qt code generator.

config BR2_PACKAGE_HOST_CC_COMMSDSL2SWIG
	bool "host commsdsl2swig"
	help
	  Code generator of the CommsChampion Ecosystem.
	  Provides commsdl2swig code generator.

config BR2_PACKAGE_HOST_CC_COMMSDSL2EMSCRIPTEN
	bool "host commsdsl2emscripten"
	help
	  Code generator of the CommsChampion Ecosystem.
	  Provides commsdl2emscripten code generator.
endif
```

## package/cc-mqtt311-libs/Config.in
```kconfig
config BR2_PACKAGE_CC_MQTT311_LIBS_CLIENT
    bool "cc_mqtt311_client library"
    depends on BR2_INSTALL_LIBSTDCPP
    select BR2_PACKAGE_CC_COMMS
    select BR2_PACKAGE_CC_MQTT311
    help
      MQTT v3.1.1 client library

if BR2_PACKAGE_CC_MQTT311_LIBS_CLIENT

    comment "cc_mqtt311_client apps require boost (program_options and system)"
        depends on !BR2_PACKAGE_BOOST_PROGRAM_OPTIONS || !BR2_PACKAGE_BOOST_SYSTEM

    config BR2_PACKAGE_CC_MQTT311_LIBS_CLIENT_APPS
        bool "cc_mqtt311_client apps"
        depends on BR2_PACKAGE_BOOST_PROGRAM_OPTIONS && BR2_PACKAGE_BOOST_SYSTEM
        help
            MQTT v3.1.1 client apps.

    if BR2_PACKAGE_CC_MQTT311_LIBS_CLIENT_APPS
        config BR2_PACKAGE_CC_MQTT311_LIBS_CLIENT_APPS_WITH_TLS
            bool "TLS support in cc_mqtt311_client apps"
            depends on BR2_PACKAGE_OPENSSL
            help
                MQTT v5 client apps with TLS support.
    endif # if BR2_PACKAGE_CC_MQTT311_LIBS_CLIENT_APPS

endif # if BR2_PACKAGE_CC_MQTT311_LIBS_CLIENT

comment "cc_mqtt311_client support needs a toolchain w/ C++"
    depends on !BR2_INSTALL_LIBSTDCPP
```

## package/cc-mqtt311/Config.in
```kconfig
config BR2_PACKAGE_CC_MQTT311
	bool "cc-mqtt311"
	depends on BR2_INSTALL_LIBSTDCPP
	select BR2_PACKAGE_CC_COMMS
	help
	  MQTT v3.1.1 protocol definition headers only library implemented using
	  COMMS library from the CommsChampion Ecosystem.

comment "cc-mqtt311 support needs a toolchain w/ C++"
	depends on !BR2_INSTALL_LIBSTDCPP
```

## package/cc-mqtt5-libs/Config.in
```kconfig
config BR2_PACKAGE_CC_MQTT5_LIBS_CLIENT
	bool "cc_mqtt5_client library"
	depends on BR2_INSTALL_LIBSTDCPP
	select BR2_PACKAGE_CC_COMMS
	select BR2_PACKAGE_CC_MQTT5
	help
	  MQTT v5 client library

if BR2_PACKAGE_CC_MQTT5_LIBS_CLIENT

	comment "cc_mqtt5_client apps require boost"
		depends on !BR2_PACKAGE_BOOST_PROGRAM_OPTIONS || !BR2_PACKAGE_BOOST_SYSTEM

	config BR2_PACKAGE_CC_MQTT5_LIBS_CLIENT_APPS
		bool "cc_mqtt5_client apps"
		depends on BR2_PACKAGE_BOOST_PROGRAM_OPTIONS && BR2_PACKAGE_BOOST_SYSTEM
		help
			MQTT v5 client apps.

endif # if BR2_PACKAGE_CC_MQTT5_LIBS_CLIENT

comment "cc_mqtt5_client support needs a toolchain w/ C++"
	depends on !BR2_INSTALL_LIBSTDCPP
```

## package/cc-mqtt5/Config.in
```kconfig
config BR2_PACKAGE_CC_MQTT5
	bool "cc-mqtt5"
	depends on BR2_INSTALL_LIBSTDCPP
	select BR2_PACKAGE_CC_COMMS
	help
	  MQTT v5 protocol definition headers only library implemented using
	  COMMS library from the CommsChampion Ecosystem.

comment "cc-mqtt5 support needs a toolchain w/ C++"
	depends on !BR2_INSTALL_LIBSTDCPP
```

## package/cc-mqttsn-libs/Config.in
```kconfig
config BR2_PACKAGE_CC_MQTTSN_LIBS
	bool "cc-mqttsn-libs"
	depends on BR2_INSTALL_LIBSTDCPP
	select BR2_PACKAGE_CC_COMMS
	select BR2_PACKAGE_CC_MQTT311
	select BR2_PACKAGE_CC_MQTTSN
	help
	  MQTT-SN client / gateway libraries.

if BR2_PACKAGE_CC_MQTTSN_LIBS

	config BR2_PACKAGE_CC_MQTTSN_LIBS_CLIENT
		bool "cc_mqttsn_client library"
		help
			MQTT-SN client library.

	if BR2_PACKAGE_CC_MQTTSN_LIBS_CLIENT

		comment "cc_mqttsn_client apps require boost"
			depends on !BR2_PACKAGE_BOOST_PROGRAM_OPTIONS || !BR2_PACKAGE_BOOST_SYSTEM

		config BR2_PACKAGE_CC_MQTTSN_LIBS_CLIENT_APPS
			bool "cc_mqttsn_client apps"
			depends on BR2_PACKAGE_BOOST_PROGRAM_OPTIONS && BR2_PACKAGE_BOOST_SYSTEM
			help
				MQTT-SN client apps.

	endif # BR2_PACKAGE_CC_MQTTSN_LIBS_CLIENT

	config BR2_PACKAGE_CC_MQTTSN_LIBS_GATEWAY
		bool "cc_mqttsn_gateway library"
		help
			MQTT-SN gateway library

	if BR2_PACKAGE_CC_MQTTSN_LIBS_GATEWAY

		comment "cc_mqttsn_gateway apps require boost"
			depends on !BR2_PACKAGE_BOOST_PROGRAM_OPTIONS || !BR2_PACKAGE_BOOST_SYSTEM

		config BR2_PACKAGE_CC_MQTTSN_LIBS_GATEWAY_APPS
			bool "cc_mqttsn_gateway apps"
			depends on BR2_PACKAGE_BOOST_PROGRAM_OPTIONS && BR2_PACKAGE_BOOST_SYSTEM
			help
				MQTT-SN gateway apps.

	endif # BR2_PACKAGE_CC_MQTTSN_LIBS_GATEWAY
endif # if BR2_PACKAGE_CC_MQTTSN_LIBS

comment "cc-mqttsn-libs support needs a toolchain w/ C++"
	depends on !BR2_INSTALL_LIBSTDCPP
```

## package/cc-mqttsn/Config.in
```kconfig
config BR2_PACKAGE_CC_MQTTSN
	bool "cc-mqttsn"
	depends on BR2_INSTALL_LIBSTDCPP
	select BR2_PACKAGE_CC_COMMS
	help
	  MQTT-SN protocol definition headers only library implemented using
	  COMMS library from the CommsChampion Ecosystem.

comment "cc-mqttsn support needs a toolchain w/ C++"
	depends on !BR2_INSTALL_LIBSTDCPP
```

## package/cc-ublox/Config.in
```kconfig
config BR2_PACKAGE_CC_UBLOX
	bool "cc-ublox"
	depends on BR2_INSTALL_LIBSTDCPP
	select BR2_PACKAGE_CC_COMMS
	help
	  UBX protocol definition headers only library implemented using
	  COMMS library from the CommsChampion Ecosystem. The UBX binary
	  protocol is used by the u-blox GPS receivers.

comment "cc-ublox support needs a toolchain w/ C++"
	depends on !BR2_INSTALL_LIBSTDCPP
```

## package/cc-x509/Config.in
```kconfig
config BR2_PACKAGE_CC_X509
	bool "cc-x509"
	depends on BR2_INSTALL_LIBSTDCPP
	select BR2_PACKAGE_CC_COMMS
	help
	  X.509 public key infrastructure implemented using
	  COMMS library from the CommsChampion Ecosystem.

comment "cc-x509 support needs a toolchain w/ C++"
	depends on !BR2_INSTALL_LIBSTDCPP
```
